## drivers/fujitsu/Kconfig
```kconfig
#
# fujitsu eiffel device driver
#

menuconfig FUJITSU_EIFFEL
	bool "Fujitsu eiffel drivers"
	default n
	---help---
	  Say Y here to get to see options for device drivers from various
	  different categories. This option alone does not add any kernel code.

	  If you say N, all options in this submenu will be skipped and disabled.

menuconfig FUJITSU_F11K06
	bool "Fujitsu f11k06 drivers"
	default y
	---help---
	  Say Y here to get to see options for device drivers from various
	  different categories. This option alone does not add any kernel code.

	  If you say N, all options in this submenu will be skipped and disabled.


config FUJITSU_F11EIF_STSCHK
	bool "Fujitsu Status Check driver"
	default y
	---help---
	  Say Y here if you want to enable the driver for the ststus check.
	  This is the driver to check root hackking.

	  the module will be called system call.

if FUJITSU_EIFFEL

config FUJITSU_EIFFEL_PROXIMITY
	bool "Fujitsu Proximity sensor Devices driver"
	default y
	---help---
	  If you say yes here you get support for the Eiffel Proximity sensor
	  chips.

	  This driver can also be built as a module. If so, the module
	  will be called proximity sensor.

config FUJITSU_EIFFEL_ILLUMI
	bool "Fujitsu Illuminance sensor Devices driver"
	depends on FUJITSU_EIFFEL_PROXIMITY
	default y
	---help---
	  If you say yes here you get support for the Eiffel Illuminance
	  sensor chips.

	  This driver can also be built as a module. If so, the module
	  will be called proximity sensor.

endif # FUJITSU_EIFFEL

source "drivers/fujitsu/keypad/Kconfig"
```

## drivers/waveif/Kconfig
```kconfig
#------------------------------------------------------------------------------#
# COPYRIGHT(C) FUJITSU LIMITED 2011
#------------------------------------------------------------------------------#
menu "Fujitsu WAVE-IF support"

config FUJITSU_WAVEIF
	tristate "Fujitsu WAVE Interface Driver"
	default y
endmenu
```
